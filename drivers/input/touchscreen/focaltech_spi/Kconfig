## drivers/input/touchscreen/focaltech_spi/Kconfig
```kconfig
#
# Focaltech Touchscreen driver configuration
#

config TOUCHSCREEN_FOCALTECH
	tristate "Focaltech Touchscreen"
	depends on SPI && INPUT_TOUCHSCREEN && TOUCHSCREEN_XIAOMI_TOUCHFEATURE
	depends on XIAOMI_DRM_NOTIFIER
	default n
	help
	  Say Y here if you have Focaltech touch panel.

	  If unsure, say N.

	  To compile this driver as a module, choose M here: the
	  module will be called focaltech_touch.
```

## drivers/power/supply/maxim/Kconfig
```kconfig
config ONEWIRE_GPIO
 bool "Xiaomi one-wire controller"
 depends on GPIOLIB
config BATT_VERIFY_BY_DS28E16
 bool "Xiaomi DS28E16 battery authentication"
 depends on ONEWIRE_GPIO
```
