// SPDX-License-Identifier: GPL-2.0-only
/* Release UFS controller uses the downstream QCOM UFS PHY interface. */
&ufs_mem_phy {
	compatible = "qcom,ufs-phy-qmp-v4";
	reg = <0 0x01d87000 0 0xe00>, <0 0x01d90000 0 0x8000>;
	reg-names = "phy_mem", "ufs_ice";
	#phy-cells = <0>;
	clock-names = "ref_clk_src", "ref_aux_clk";
	lanes-per-direction = <2>;
};
&ufs_mem_phy_lanes { status = "disabled"; };
&ufs_mem_hc {
	phys = <&ufs_mem_phy>;
	phy-names = "ufsphy";
};
